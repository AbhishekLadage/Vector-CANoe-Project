/*@!Encoding:1252*/
includes
{
  
}

variables
{
message 123 a;
}
on sysvar headlight::sysswitch
{
 if(@headlight::sysswitch==1)
{
  //while(@headlight::sysswitch==1);
 //sw pressed
  a.rtr=0;
  a.dlc=1;
  a.byte(0)=0xaa;
  output(a);
  write("Node A:indicator blink ");
}
else if(@headlight::sysswitch==0)
{
  //while(@headlight::sysswitch==0);
 //sw released
  a.rtr=0;
  a.dlc=1;
  a.byte(0)=0xbb;
  output(a);
  write("Node A:indicator blink stop");
}
}
 